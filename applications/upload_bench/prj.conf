## prj.conf
```kconfig
# Upload-only application infrastructure; no product services.
CONFIG_FPU=y
CONFIG_FPU_SHARING=y
CONFIG_ASSERT=n
CONFIG_SPIN_VALIDATE=n
CONFIG_MEM_SLAB_POINTER_VALIDATE=n
CONFIG_MAIN_STACK_SIZE=6144
CONFIG_HEAP_MEM_POOL_SIZE=73728
CONFIG_REBOOT=y
CONFIG_PM=y
CONFIG_PM_DEVICE=y
CONFIG_PM_DEVICE_RUNTIME=y
CONFIG_TICKLESS_KERNEL=y
CONFIG_THREAD_MONITOR=y
CONFIG_THREAD_NAME=y
CONFIG_THREAD_RUNTIME_STATS=y
CONFIG_THREAD_RUNTIME_STATS_USE_TIMING_FUNCTIONS=n
CONFIG_INIT_STACKS=y
CONFIG_STACK_SENTINEL=n
CONFIG_SYS_HEAP_RUNTIME_STATS=y
CONFIG_CORTEX_M_DWT=y
CONFIG_RETAINED_MEM=y
CONFIG_RETENTION=y
CONFIG_RETENTION_BOOT_MODE=y
CONFIG_GPIO=y
CONFIG_REGULATOR=y
CONFIG_I2C=y
CONFIG_MFD=y
CONFIG_SENSOR=y
CONFIG_NPM13XX_CHARGER=y
CONFIG_FLASH=y
CONFIG_FLASH_MAP=y
CONFIG_SETTINGS=y
CONFIG_FILE_SYSTEM=y
CONFIG_FILE_SYSTEM_LITTLEFS=y
CONFIG_FS_LITTLEFS_FMP_DEV=y
CONFIG_FS_LITTLEFS_FC_HEAP_SIZE=4096
CONFIG_FS_LITTLEFS_NUM_FILES=16
CONFIG_FS_LITTLEFS_NUM_DIRS=4
CONFIG_FAT_FILESYSTEM_ELM=y
CONFIG_FS_FATFS_LFN=y
CONFIG_FS_FATFS_LFN_MODE_HEAP=y
CONFIG_FS_FATFS_REENTRANT=y
CONFIG_DISK_ACCESS=y
CONFIG_DISK_DRIVER_SDMMC=y
CONFIG_SETTINGS_FILE=y
CONFIG_SETTINGS_FILE_PATH="/lfs/settings/run"
CONFIG_SETTINGS_FILE_MAX_LINES=16
CONFIG_SYSTEM_WORKQUEUE_STACK_SIZE=4096
CONFIG_NEWLIB_LIBC=y
CONFIG_NEWLIB_LIBC_NANO=y
CONFIG_NO_OPTIMIZATIONS=n
CONFIG_DEBUG_OPTIMIZATIONS=n
CONFIG_SPEED_OPTIMIZATIONS=n
CONFIG_SIZE_OPTIMIZATIONS=n
CONFIG_SIZE_OPTIMIZATIONS_AGGRESSIVE=y
CONFIG_ISR_TABLES_LOCAL_DECLARATION=y
CONFIG_LTO=y
CONFIG_NRF_WIFI_FW_FLASH_CHUNK_SIZE=2048
CONFIG_NRF_WIFI_FW_PATCH_INTEGRITY_CHECK=y
CONFIG_WIFI=y
CONFIG_WIFI_NRF70=y
CONFIG_NRF70_AP_MODE=n
CONFIG_NRF70_SR_COEX=y
CONFIG_WIFI_NM_WPA_SUPPLICANT=y
CONFIG_WIFI_NM_WPA_SUPPLICANT_AP=n
CONFIG_WIFI_NM_WPA_SUPPLICANT_WPA3_IMPLEMENTATION_NONE=y
CONFIG_WIFI_RANDOM_MAC_ADDRESS=y
CONFIG_WIFI_READY_LIB=y
CONFIG_NRF_WIFI_IF_AUTO_START=n
CONFIG_NRF70_QSPI_LOW_POWER=y
CONFIG_NETWORKING=y
CONFIG_NET_L2_ETHERNET=y
CONFIG_NET_L2_WIFI_MGMT=y
CONFIG_NET_IPV4=y
CONFIG_NET_IPV6=n
CONFIG_NET_UDP=y
CONFIG_NET_TCP=n
CONFIG_NET_SOCKETS=y
CONFIG_NET_DHCPV4=y
CONFIG_NET_DHCPV4_SERVER=n
CONFIG_NET_MGMT=y
CONFIG_NET_MGMT_EVENT=y
CONFIG_NET_CONFIG_SETTINGS=y
CONFIG_NET_CONFIG_INIT_TIMEOUT=0
CONFIG_NET_LOG=n
CONFIG_NET_IF_UNICAST_IPV4_ADDR_COUNT=1
CONFIG_NET_CONFIG_MY_IPV4_ADDR="192.168.4.1"
CONFIG_NET_CONFIG_MY_IPV4_NETMASK="255.255.255.0"
CONFIG_NET_CONFIG_MY_IPV4_GW="192.168.4.1"
CONFIG_MBEDTLS_HEAP_SIZE=1024
CONFIG_NET_PKT_RX_COUNT=8
CONFIG_NET_PKT_TX_COUNT=24
CONFIG_NET_BUF_RX_COUNT=16
CONFIG_NET_BUF_TX_COUNT=32
CONFIG_NET_PKT_BUF_TX_DATA_POOL_SIZE=24576
CONFIG_NRF70_RX_NUM_BUFS=8
CONFIG_NRF70_MAX_TX_AGGREGATION=4
CONFIG_NRF_WIFI_CTRL_HEAP_SIZE=20000
CONFIG_NRF_WIFI_DATA_HEAP_SIZE=40000
CONFIG_NET_TC_TX_COUNT=1
CONFIG_NET_MAX_CONTEXTS=8
CONFIG_NET_MAX_CONN=6
CONFIG_NET_CONTEXT_SYNC_RECV=y
CONFIG_NET_SOCKETS_POLL_MAX=4
CONFIG_NET_TCP_TIME_WAIT_DELAY=0
CONFIG_NET_TCP_WORKQ_STACK_SIZE=2048
CONFIG_NET_RX_STACK_SIZE=2048
CONFIG_NET_TX_STACK_SIZE=2048
CONFIG_NRF70_IRQ_WQ_STACK_SIZE=1024
CONFIG_WIFI_NM_WPA_SUPPLICANT_THREAD_STACK_SIZE=10240
CONFIG_WIFI_NM_WPA_SUPPLICANT_WQ_STACK_SIZE=2048
CONFIG_POSIX_TIMERS=y
CONFIG_ENTROPY_GENERATOR=y
CONFIG_HWINFO=y
CONFIG_USB_DEVICE_STACK_NEXT=y
CONFIG_USBD_CDC_ACM_CLASS=y
CONFIG_SERIAL=y
CONFIG_UART_INTERRUPT_DRIVEN=y
CONFIG_UART_LINE_CTRL=y
CONFIG_LOG=n
CONFIG_BT=n
CONFIG_AUDIO=n
CONFIG_DISPLAY=n
CONFIG_GPIO_BUTTON=n
CONFIG_CLIP_UPLOAD_BENCH=y
CONFIG_CLIP_HTTPS_POC=y
CONFIG_CLIP_AT_SERVER_STACK_SIZE=8192
CONFIG_CLIP_HTTPS_EXPERIMENT=n
CONFIG_NET_TCP_MAX_SEND_WINDOW_SIZE=16384
CONFIG_CLIP_USB_DFU_DEFAULT_CDC=n
CONFIG_CLIP_HAPTIC_MOTOR_ENABLED=n
CONFIG_CLIP_AUDIO_ENABLED=n
CONFIG_CLIP_STORAGE_FILES_PER_GROUP=100
CONFIG_NRFX_CLOCK=y
# ECDH was previously selected indirectly by BLE; HTTPS needs it explicitly.
CONFIG_PSA_WANT_ALG_ECDH=y
# Board driver defaults otherwise select DISPLAY even without a UI service.
CONFIG_OLED_DISPLAY=n
# TLS creates an ephemeral EC key pair; these were selected by BLE SMP before.
CONFIG_PSA_WANT_KEY_TYPE_ECC_KEY_PAIR_EXPORT=y
CONFIG_PSA_WANT_KEY_TYPE_ECC_KEY_PAIR_GENERATE=y
CONFIG_PSA_WANT_KEY_TYPE_ECC_KEY_PAIR_IMPORT=y
CONFIG_CLIP_RESOURCE_STATS=y
CONFIG_CLIP_HTTPS_TUNING=y
CONFIG_CLIP_HTTPS_TCP_NODELAY=y
```

## cache.conf
```kconfig
# Same-image cache OFF/ON experiment. The 64 KiB cache is always reserved.
# Reduce the oversized TX pool by 32 KiB to fit; keep all other limits equal.
CONFIG_CLIP_UPLOAD_BENCH_CACHE=y
CONFIG_CLIP_UPLOAD_BENCH_WHOLE=y
CONFIG_NET_PKT_BUF_TX_DATA_POOL_SIZE=65536
```

## down-peak.conf
```kconfig
# Dedicated receive-ceiling diagnostic. Reallocate the upload TX pool to RX.
CONFIG_NET_PKT_BUF_RX_DATA_POOL_SIZE=65536
CONFIG_NET_PKT_RX_COUNT=64
CONFIG_NET_BUF_RX_COUNT=128
CONFIG_NET_PKT_BUF_TX_DATA_POOL_SIZE=16384
CONFIG_NET_PKT_TX_COUNT=24
CONFIG_NET_BUF_TX_COUNT=32
```

## dtls.conf
```kconfig
# Standard DTLS 1.2 experiment; retains certificate/hostname validation.
CONFIG_CLIP_UPLOAD_BENCH_DTLS=y
CONFIG_MBEDTLS_SSL_PROTO_DTLS=y
```

## large-tx.conf
```kconfig
# Single-connection ceiling experiment; retain TLS verification and protocol.
# Current SDK caps NET_TCP_MAX_SEND_WINDOW_SIZE at UINT16_MAX (65535).
CONFIG_NET_PKT_BUF_TX_DATA_POOL_SIZE=98304
CONFIG_NET_TCP_MAX_SEND_WINDOW_SIZE=65535
# Supply packet/fragment descriptors as well as payload bytes.
CONFIG_NET_PKT_TX_COUNT=64
CONFIG_NET_BUF_TX_COUNT=128
CONFIG_HEAP_MEM_POOL_SIZE=98304
```

## src/main.c
```c
/* SPDX-License-Identifier: Apache-2.0 */
#include <zephyr/kernel.h>
#include <zephyr/init.h>
#include <stdio.h>
#include <string.h>
#include "config.h"
#include "storage.h"
#include "wifi.h"
#include "https_poc.h"
#include "at_server.h"
#include "resource_stats.h"
#include "usb_cdc.h"

static atomic_t init_error=ATOMIC_INIT(-EAGAIN);
static int status(struct at_cmd_ctx *ctx,char *out,size_t length)
{
    ARG_UNUSED(ctx);
    return snprintf(out,length,"{\"ok\":true,\"data\":{\"state\":\"%s\",\"recording\":false,"
        "\"device\":\"Clip Upload Bench\",\"upload_only\":true,\"init_error\":%d}}\n",
        atomic_get(&init_error) ? "ERROR" : "IDLE",(int)atomic_get(&init_error));
}
static int version(struct at_cmd_ctx *ctx,char *out,size_t length)
{
    ARG_UNUSED(ctx);
    return snprintf(out,length,"{\"ok\":true,\"data\":{\"variant\":\"upload-only\",\"base\":\"0.1.2\"}}\n");
}
static int usb(struct at_cmd_ctx *ctx,char *out,size_t length)
{
    if (ctx->type==AT_CMD_TYPE_SET && strcmp(ctx->args,"on")) {
        return snprintf(out,length,"{\"ok\":false,\"msg\":\"USB remains on for recovery\"}\n");
    }
    return snprintf(out,length,"{\"ok\":true,\"data\":{\"status\":\"on\"}}\n");
}
static int crystal_init(void)
{
    NRF_OSCILLATORS->XOSC32MCAPS=
        (OSCILLATORS_XOSC32MCAPS_ENABLE_Enabled<<OSCILLATORS_XOSC32MCAPS_ENABLE_Pos)|
        (CONFIG_CLIP_HFXO_CAPVALUE<<OSCILLATORS_XOSC32MCAPS_CAPVALUE_Pos);
    NRF_OSCILLATORS->XOSC32KI.INTCAP=CONFIG_CLIP_LFXO_INTCAP;
    return 0;
}
SYS_INIT(crystal_init,POST_KERNEL,0);
int main(void)
{
    static const struct at_command commands[]={
        {"GSTAT",AT_CMD_EXEC|AT_CMD_QUERY,status},
        {"VERSION",AT_CMD_EXEC|AT_CMD_QUERY,version},
        {"USB",AT_CMD_SET|AT_CMD_QUERY,usb},
    };
    for (size_t i=0;i<ARRAY_SIZE(commands);i++) {
        int ret=at_server_register_cmd(&commands[i]);if(ret){return ret;}
    }
    int ret=resource_stats_register();
    if (!ret) { ret=at_server_init(); }
    if (!ret) { ret=usb_cdc_init(); }
    if (!ret) { ret=usb_cdc_enable(); }
    if (ret) { return ret; }
    ret=config_init();
    if (!ret) { ret=storage_init(); }
    if (!ret) { ret=wifi_init(); }
    if (!ret) { ret=https_poc_register(); }
    atomic_set(&init_error,ret);
    /* USB stays available even when mounting or network initialization fails. */
    k_sleep(K_FOREVER);
    return ret;
}
```

## src/platform.c
```c
/* SPDX-License-Identifier: Apache-2.0 */
#include "clip_event.h"
#include "https_poc.h"
#include "config.h"
#include <zephyr/fs/fs.h>
#include <zephyr/fs/littlefs.h>
#include <zephyr/storage/flash_map.h>
#include <zephyr/settings/settings.h>
#include <zephyr/sys/reboot.h>
#include <errno.h>
#include <nrfx_clock.h>
#include "upload_bench_cpu.h"

unsigned int upload_bench_cpu_mhz(void)
{
#ifdef CLOCK_FEATURE_HFCLK_DIVIDE_PRESENT
    nrf_clock_hfclk_div_t divider = nrf_clock_hfclk_div_get(NRF_CLOCK);
    if (divider == NRF_CLOCK_HFCLK_DIV_1) { return 128; }
    if (divider == NRF_CLOCK_HFCLK_DIV_2) { return 64; }
#endif
    return 0;
}
int upload_bench_cpu_set(unsigned int mhz)
{
    if (mhz != 64 && mhz != 128) { return -EINVAL; }
#ifdef CLOCK_FEATURE_HFCLK_DIVIDE_PRESENT
    nrfx_clock_divider_set(NRF_CLOCK_DOMAIN_HFCLK,
                           mhz == 128 ? NRF_CLOCK_HFCLK_DIV_1 : NRF_CLOCK_HFCLK_DIV_2);
    k_busy_wait(20);
    return upload_bench_cpu_mhz() == mhz ? 0 : -EIO;
#else
    return -ENOTSUP;
#endif
}

static K_MUTEX_DEFINE(events);
FS_LITTLEFS_DECLARE_DEFAULT_CONFIG(lfs);
static struct fs_mount_t mount = {
    .type=FS_LITTLEFS,.fs_data=&lfs,.mnt_point="/lfs",
    .storage_dev=(void *)FIXED_PARTITION_ID(lfs_storage),.flags=FS_MOUNT_FLAG_NO_FORMAT,
};
static atomic_t settings_loading;
static void timeout(struct k_work *work)
{
    ARG_UNUSED(work);
    /* Recover from a stuck read without erasing credentials or recordings. */
    if (atomic_get(&settings_loading)) { sys_reboot(SYS_REBOOT_COLD); }
}
static K_WORK_DELAYABLE_DEFINE(watchdog,timeout);
void settings_load_watchdog_arm(void)
{
    atomic_set(&settings_loading,1);
    k_work_reschedule(&watchdog,K_MSEC(CONFIG_CLIP_SETTINGS_LOAD_TIMEOUT_MS));
}
void settings_load_watchdog_disarm(void)
{
    atomic_clear(&settings_loading);
    k_work_cancel_delayable(&watchdog);
}
int config_init(void)
{
    int ret=fs_mount(&mount);
    if (ret && ret!=-EBUSY) { return ret; }
    ret=fs_mkdir("/lfs/settings");
    if (ret && ret!=-EEXIST) { return ret; }
    return settings_subsys_init();
}
int config_set_time(int64_t timestamp)
{
    return settings_save_one("time/unix_timestamp",&timestamp,sizeof(timestamp));
}
const char *config_get_wifi_reg_domain(void) { return CONFIG_CLIP_WIFI_AP_REG_DOMAIN; }
enum clip_state clip_event_get_state(void) { return CLIP_STATE_IDLE; }
int clip_post_event_sync(enum clip_event event,struct clip_event_result_info *result)
{
    if (!result) { return -EINVAL; }
    if (event!=CLIP_EVENT_UPLOAD_BEGIN && event!=CLIP_EVENT_UPLOAD_END) {
        result->result=CLIP_EVENT_INVALID;result->error_code=-ENOTSUP;
        return -ENOTSUP;
    }
    k_mutex_lock(&events,K_FOREVER);
    bool handled=https_poc_event(event,result,true);
    k_mutex_unlock(&events);
    return handled ? 0 : -ENOTSUP;
}
```

## src/storage.c
```c
/* SPDX-License-Identifier: Apache-2.0 */
/* Read existing recordings; upload_state owns durable progress writes. */
#include "storage.h"
#include <zephyr/device.h>
#include <zephyr/drivers/regulator.h>
#include <zephyr/storage/disk_access.h>
#include <ff.h>
#include <errno.h>
#include <stdio.h>
#include <string.h>

static FATFS fat;
static struct fs_mount_t mount = {.type=FS_FATFS,.fs_data=&fat,.mnt_point="/SD:"};
static bool mounted;
static K_MUTEX_DEFINE(lifecycle);
static K_MUTEX_DEFINE(metadata);

int storage_ensure_mounted(void)
{
    k_mutex_lock(&lifecycle, K_FOREVER);
    int ret = 0;
    if (!mounted) {
        const struct device *rail = DEVICE_DT_GET(DT_NODELABEL(npm1300_ldo2));
        if (!device_is_ready(rail)) { ret = -ENODEV; goto done; }
        ret = regulator_enable(rail);
        if (ret) { goto done; }
        k_msleep(10);
        ret = disk_access_init("SD");
        if (!ret) { ret = fs_mount(&mount); }
        mounted = ret == 0;
    }
done:
    k_mutex_unlock(&lifecycle);
    return ret;
}
int storage_init(void) { return storage_ensure_mounted(); }
void storage_session_json_lock(void) { k_mutex_lock(&metadata, K_FOREVER); }
void storage_session_json_unlock(void) { k_mutex_unlock(&metadata); }

static int session_path(const char *session, char *path, size_t length)
{
    if (!session || strlen(session) != 14 || !path || !length) { return -EINVAL; }
    for (const char *p=session; *p; p++) {
        if (*p<'0' || *p>'9') { return -EINVAL; }
    }
    int n=snprintf(path,length,"/SD:/REC/%.8s/%.2s/%.2s/%.2s",session,session+8,session+10,session+12);
    if (n<0 || (size_t)n>=length) { path[0]=0; return -ENAMETOOLONG; }
    return 0;
}
static int append_path(const char *session, char *path, size_t length,
                       uint32_t segment, bool metadata_path)
{
    char directory[STORAGE_PATH_MAX];
    int ret=session_path(session,directory,sizeof(directory));
    if (ret || !path || !length) { return ret ? ret : -EINVAL; }
    int n=metadata_path ? snprintf(path,length,"%s/session.json",directory) :
        snprintf(path,length,"%s/%u/%04u.opus",directory,
                 (unsigned)((segment-1)/CONFIG_CLIP_STORAGE_FILES_PER_GROUP),(unsigned)segment);
    if (n<0 || (size_t)n>=length) { path[0]=0; return -ENAMETOOLONG; }
    return 0;
}
int storage_build_chunk_path(const char *session, uint32_t segment, char *path, size_t length)
{
    return segment ? append_path(session,path,length,segment,false) : -EINVAL;
}
int storage_build_session_metadata_path(const char *session, char *path, size_t length)
{
    return append_path(session,path,length,1,true);
}
```

## src/usb.c
```c
/*
 * Copyright (c) 2025 Seeed Technology Co., Ltd.
 *
 * SPDX-License-Identifier: Apache-2.0
 */

#include <zephyr/kernel.h>
#include <zephyr/logging/log.h>
#include <zephyr/usb/usbd.h>

#include <zephyr/drivers/uart.h>

#include "usb_cdc.h"


#include "at_server.h"
#include "transport.h"


#include "clip_usb_dfu.h"

LOG_MODULE_REGISTER(usb, CONFIG_CLIP_LOG_LEVEL);

/* USB device definition (Seeed VID 0x2886) */
USBD_DEVICE_DEFINE(clip_usbd,
		   DEVICE_DT_GET(DT_NODELABEL(usbd)),
		   0x2886, 0x0069);

/* String descriptors */
USBD_DESC_LANG_DEFINE(clip_lang);
USBD_DESC_MANUFACTURER_DEFINE(clip_mfr, "Seeed Studio");
USBD_DESC_PRODUCT_DEFINE(clip_product, "Clip Upload Bench");

/* Configuration descriptor (bus-powered, 100mA) */
USBD_DESC_CONFIG_DEFINE(clip_fs_cfg, "Default");
USBD_CONFIGURATION_DEFINE(clip_fs_config, 0, 100, &clip_fs_cfg);

/* MSC LUN: SD card */

/* CDC ACM UART device */
static const struct device *const cdc_dev =
	DEVICE_DT_GET(DT_NODELABEL(cdc_acm_uart));

/* RX state */
static uint8_t rx_line_buf[CONFIG_CLIP_AT_MAX_CMD_LEN];
static uint16_t rx_line_pos;

static bool usb_active;
struct usbd_context *usb_cdc_get_usbd(void)
{
	return &clip_usbd;
}

bool usb_cdc_is_connected(void)
{
	return usb_active;
}

/* Submit accumulated line to AT server */
static void submit_rx_line(uint16_t len)
{
	if (len == 0) {
		return;
	}

	if (len > 0 && rx_line_buf[len - 1] == '\r') {
		len--;
	}

	if (len == 0) {
		return;
	}

	at_server_submit_cmd(rx_line_buf, len, TRANSPORT_TYPE_USB);
}

/* UART interrupt handler */
static void cdc_irq_handler(const struct device *dev, void *user_data)
{
	ARG_UNUSED(user_data);

	while (uart_irq_update(dev) && uart_irq_is_pending(dev)) {
		if (uart_irq_rx_ready(dev)) {
			uint8_t byte;
			int recv = uart_fifo_read(dev, &byte, 1);

			if (recv > 0) {
				if (byte == '\n') {
					submit_rx_line(rx_line_pos);
					rx_line_pos = 0;
				} else if (byte != '\r') {
					if (rx_line_pos < sizeof(rx_line_buf) - 1) {
						rx_line_buf[rx_line_pos++] = byte;
					}
				}
			}
		}
	}
}

int usb_cdc_send_response(const uint8_t *data, uint16_t len)
{
	if (!usb_active || len == 0) {
		return 0;
	}

	for (uint16_t i = 0; i < len; i++) {
		uart_poll_out(cdc_dev, data[i]);
	}

	return len;
}

static void usb_msg_cb(struct usbd_context *const ctx,const struct usbd_msg *msg)
{
    ARG_UNUSED(ctx);
    clip_usb_dfu_check(msg);
    if (msg->type==USBD_MSG_CDC_ACM_CONTROL_LINE_STATE) {
        uint32_t dtr=0;
        uart_line_ctrl_get(msg->dev,UART_LINE_CTRL_DTR,&dtr);
        if(dtr){uart_irq_rx_enable(cdc_dev);}else{uart_irq_rx_disable(cdc_dev);}
    }
}

int usb_cdc_init(void)
{
	int err;

	if (!device_is_ready(cdc_dev)) {
		LOG_ERR("CDC ACM device not ready");
		return -ENODEV;
	}

	/* Add USB descriptors */
	usbd_add_descriptor(&clip_usbd, &clip_lang);
	usbd_add_descriptor(&clip_usbd, &clip_mfr);
	usbd_add_descriptor(&clip_usbd, &clip_product);

	/* Add FS configuration */
	err = usbd_add_configuration(&clip_usbd, USBD_SPEED_FS, &clip_fs_config);
	if (err) {
		LOG_ERR("add config: %d", err);
		return err;
	}

	/* Register CDC ACM + MSC classes */
	err = usbd_register_class(&clip_usbd, "cdc_acm_0", USBD_SPEED_FS, 1);
	if (err) {
		LOG_ERR("CDC class: %d", err);
		return err;
	}

	/* Initialize USB device */
	err = usbd_init(&clip_usbd);
	if (err) {
		LOG_ERR("usbd init: %d", err);
		return err;
	}

	/* Register message callback */
	usbd_msg_register_cb(&clip_usbd, usb_msg_cb);

	/* Setup UART interrupt callback */
	uart_irq_callback_set(cdc_dev, cdc_irq_handler);

	return 0;
}

int usb_cdc_enable(void)
{
    if(usb_active){return 0;}
    int ret=usbd_enable(&clip_usbd);
    if(!ret){usb_active=true;}
    return ret;
}
bool usb_cdc_is_enabled(void){return usb_active;}
```
