## CMakeLists.txt
```
# SPDX-License-Identifier: Apache-2.0

cmake_minimum_required(VERSION 3.20)

find_package(Zephyr REQUIRED HINTS $ENV{ZEPHYR_BASE})
project(clip)

if(CONFIG_CLIP_NETWORK_BACKPORT_DHCP)
    include(network-backports.cmake)
endif()

target_sources_ifdef(CONFIG_CLIP_RESOURCE_STATS app PRIVATE src/resource_stats.c)
target_sources_ifdef(CONFIG_CLIP_WIFI_DIAG app PRIVATE src/wifi_diag.c)
target_sources_ifdef(CONFIG_CLIP_TCP_TRACE app PRIVATE src/tcp_trace.c)
if(CONFIG_CLIP_WIFI_DIAG)
    target_sources(app PRIVATE src/wifi_trace.c)
    include(wifi-trace.cmake)
endif()

# TLS timing uses a generated source copy so LTO cannot bypass the AEAD hooks.
if(CONFIG_CLIP_DTLS_PROFILE)
    target_sources(app PRIVATE src/dtls_profile.c)
    execute_process(COMMAND "${PYTHON_EXECUTABLE}"
        "${CMAKE_CURRENT_SOURCE_DIR}/../../tools/https_poc/instrument_dtls_crypto.py"
        --zephyr "${ZEPHYR_BASE}" --output "${_trace_dir}/ssl_msg.c"
        RESULT_VARIABLE _dtls_timing_result)
    if(NOT _dtls_timing_result EQUAL 0)
        message(FATAL_ERROR "Pinned SDK DTLS timing could not be generated")
    endif()
    clip_trace_source(mbedtls ../modules/crypto/mbedtls/library/ssl_msg.c)
endif()

# Include directories
target_include_directories(app PRIVATE include)

# Source files
target_sources(app PRIVATE
    src/main.c
    src/clip_event.c
    src/config.c
    src/ble.c
    src/transport.c
    src/transport_ble.c
    src/at_server.c
    src/at_commands.c
    src/audio.c
    src/storage.c
    src/transfer.c
    src/haptic.c
    src/button.c
    src/display.c
    src/icons.c
    src/wifi_udp.c
    src/transport_udp.c
    src/battery.c
    src/usb_cdc.c
)

if(CONFIG_CLIP_HTTPS_POC)
    # NCS nrf-config.h does not expose Zephyr's HAVE_TIME_DATE Kconfig option.
    # Apply to the entire application image including its TLS/X.509 libraries.
    zephyr_compile_definitions(MBEDTLS_HAVE_TIME MBEDTLS_HAVE_TIME_DATE MBEDTLS_PLATFORM_MS_TIME_ALT)
    # This SDK's config_adjust_ssl.h detects TLS 1.2 ECC only through the
    # legacy ECDH/ECDSA modules. With PSA-only crypto it omits supported_groups
    # from ClientHello, causing OpenSSL to reject otherwise shared ECDHE suites.
    # Keep the compatibility definition app-only and retain the PSA backend.
    if(CONFIG_MBEDTLS_USE_PSA_CRYPTO AND CONFIG_PSA_WANT_ALG_ECDH
       AND CONFIG_MBEDTLS_SSL_PROTO_TLS1_2)
        zephyr_compile_definitions("MBEDTLS_SSL_TLS1_2_SOME_ECC=")
    endif()
    # Hostap selects MBEDTLS_ENABLE_HEAP unconditionally in this NCS version.
    # Replace only this image's initializer, at the SDK's original init priority;
    # leave the shared SDK and its public calloc/free API unchanged.
    get_target_property(_tls_sources mbedtls_zephyr SOURCES)
    set(_tls_initializers ${_tls_sources})
    list(FILTER _tls_initializers INCLUDE REGEX "(^|/)mbedtls_heap[.]c$")
    list(LENGTH _tls_initializers _tls_count)
    if(NOT _tls_count EQUAL 1)
        message(FATAL_ERROR "NCS heap initializer changed: review HTTPS allocator integration")
    endif()
    list(GET _tls_initializers 0 _tls_original)
    list(REMOVE_ITEM _tls_sources "${_tls_original}")
    list(APPEND _tls_sources "${CMAKE_CURRENT_SOURCE_DIR}/src/tls_allocator.c")
    set_property(TARGET mbedtls_zephyr PROPERTY SOURCES "${_tls_sources}")
    if(NOT CLIP_HTTPS_CA_FILE)
        set(CLIP_HTTPS_CA_FILE "$ENV{CLIP_HTTPS_CA_FILE}")
    endif()
    if(NOT CLIP_HTTPS_CA_FILE OR NOT EXISTS "${CLIP_HTTPS_CA_FILE}")
        message(FATAL_ERROR "Set CLIP_HTTPS_CA_FILE to the trusted test CA PEM (not a private key)")
    endif()
    file(READ "${CLIP_HTTPS_CA_FILE}" _ca_pem)
    if(NOT _ca_pem MATCHES "BEGIN CERTIFICATE" OR _ca_pem MATCHES "PRIVATE KEY")
        message(FATAL_ERROR "CLIP_HTTPS_CA_FILE must contain public CA certificate(s), not keys")
    endif()
    file(READ "${CLIP_HTTPS_CA_FILE}" _ca_hex HEX)
    string(REGEX REPLACE "(..)" "0x\\1," _ca_bytes "${_ca_hex}")
    file(WRITE "${PROJECT_BINARY_DIR}/https_ca.h"
        "static const unsigned char https_ca[] = {${_ca_bytes}0};\n")
    target_include_directories(app PRIVATE "${PROJECT_BINARY_DIR}")
    target_sources(app PRIVATE src/wifi_station.c src/https_poc.c src/upload_state.c src/upload_config.c src/upload_scan.c)
    target_sources_ifdef(CONFIG_CLIP_RECORDING_HASH app PRIVATE src/recording_hash.c)
    target_sources_ifdef(CONFIG_CLIP_HTTPS_PROFILE app PRIVATE src/upload_perf.c)
    if(CONFIG_CLIP_DTLS_UPLOAD)
        target_sources(app PRIVATE src/dtls_upload.c src/upload_window.c)
    else()
        target_sources(app PRIVATE src/https_stream.c)
    endif()
else()
    target_sources(app PRIVATE src/wifi.c)
endif()
```

## Kconfig
```
#
# Copyright (c) 2025 Seeed Technology Co., Ltd.
#
# SPDX-License-Identifier: Apache-2.0
#

source "Kconfig.zephyr"

# Main application
menuconfig CLIP
	bool "Clip Application"
	default y

if CLIP

config CLIP_DTLS_UPLOAD
	bool "Durable recording upload over DTLS"
	depends on CLIP_HTTPS_POC
	select MBEDTLS_SSL_PROTO_DTLS
	default n
	help
	  Full recording application with one authenticated datagram connection,
	  selective receive credit and server-authoritative durable checkpoints.
	  Reuses the existing scheduler, configuration and independent A/B state.

config CLIP_DTLS_PROFILE
	bool "DTLS data-phase timing counters"
	depends on CLIP_DTLS_UPLOAD && CLIP_WIFI_DIAG
	default n
	help
	  Measure source reads, AEAD, UDP calls and explicit waits in RAM.
	  Uses pinned build-local TLS source instrumentation, with no log output.

config CLIP_RECORDING_HASH
	bool "Cache sealed recording SHA-256 while writing"
	depends on CLIP_DTLS_UPLOAD
	default y
	help
	  Incrementally hash successful recording writes, including frame headers.
	  Publish CRC-protected content metadata only after data sync and close.
	  Uploads without valid metadata retain the full-file hashing fallback.

config CLIP_DTLS_WINDOW_PACKETS
	int "Maximum logical DTLS in-flight packets"
	depends on CLIP_DTLS_UPLOAD
	range 16 128
	default 64
	help
	  One packet is 1024 bytes. Only retransmission metadata occupies RAM;
	  payload is reread from SD. The initial window is configured separately.

config CLIP_DTLS_INITIAL_WINDOW_PACKETS
	int "Initial logical DTLS in-flight packets"
	depends on CLIP_DTLS_UPLOAD
	range 16 128
	default 16
	help
	  Must not exceed CLIP_DTLS_WINDOW_PACKETS. Loss still reduces the window.

config CLIP_DTLS_READ_CACHE_BYTES
	int "DTLS DATA read-ahead cache bytes"
	depends on CLIP_DTLS_UPLOAD
	range 4096 16384
	default 4096
	help
	  Sizes above4096 allocate a separate per-file heap buffer. The4KiB hash
	  buffer is retained. This setting also applies when timing is disabled.

config CLIP_HTTPS_POC
	bool "Experimental USB-controlled HTTPS upload"
	default n
	help
	  Station-only, stopped-recording upload. Uses CDC-only USB and disables
	  application OTA during this experiment. Requires a supplied test CA.

config CLIP_HTTPS_PROFILE
	bool "Passive upload phase timing via USB"
	depends on CLIP_HTTPS_POC
	default n
	help
	  Opt-in bounded RAM event ring; no audio or credential logging.
	  Disabled builds compile timing hooks to no-ops.

config CLIP_DTLS_PREPARE_MEASURE
	bool "Diagnostic DTLS session replay and preparation measurement"
	depends on CLIP_DTLS_PROFILE && CLIP_HTTPS_PROFILE
	default n
	help
	  Diagnostic-only session filter, one-pass replay and fresh hash calculation.
	  Allows idle session deletion only while automatic upload is disabled.
	  Does not alter transport parameters or file contents.

config CLIP_TCP_TRACE
	bool "Passive TCP retransmission observations via USB"
	depends on CLIP_WIFI_DIAG && NET_TCP_CONGESTION_AVOIDANCE && NET_TCP_FAST_RETRANSMIT
	default n
	help
	  Diagnostic image only. Replaces pinned SDK tcp.c with an instrumented
	  build-local copy. USB enables an 8196-byte bounded RAM ring while idle.
	  Does not change TCP timers, windows, packet contents or scheduling.

config CLIP_HTTPS_STA_PS_OFF
	bool "Disable station power save before experimental HTTPS upload"
	depends on CLIP_HTTPS_POC
	default n
	help
	  Diagnostic comparison only: request WIFI_PS_DISABLED after DHCP and
	  coexistence setup. Keep driver low-power support, TCP timeout, buffers,
	  and idle radio shutdown unchanged. Fail the job if the request fails.

config CLIP_NETWORK_BACKPORT_DHCP
	bool "Experimental pinned-SDK DHCP INIT-REBOOT fixes"
	depends on CLIP_HTTPS_POC && NET_DHCPV4_INIT_REBOOT
	default n

config CLIP_DHCP_REBOOT_ATTEMPTS
	int "INIT-REBOOT requests before falling back to DISCOVER"
	depends on CLIP_NETWORK_BACKPORT_DHCP
	range 1 255
	default 1

config CLIP_NETWORK_BACKPORT_ARP
	bool "Experimental pinned-SDK ARP pending-entry fixes"
	depends on CLIP_HTTPS_POC && CLIP_WIFI_DIAG
	default n
	help
	  Generate fixed ARP source together with the existing passive diagnostics.
	  Keep this separate from the DHCP experiment for a controlled comparison.

module = CLIP
module-str = Clip Application
source "subsys/logging/Kconfig.template.log_config"

# =============================================================================
# Configuration Defaults
# =============================================================================

config CLIP_NORMAL_BITRATE
	int "Normal mode Opus bitrate (bps)"
	default 32000

config CLIP_NORMAL_COMPLEXITY
	int "Normal mode Opus complexity (0-10)"
	range 0 10
	default 1

config CLIP_ENHANCED_BITRATE
	int "Enhanced mode Opus bitrate (bps)"
	default 32000

config CLIP_ENHANCED_COMPLEXITY
	int "Enhanced mode Opus complexity (0-10)"
	range 0 10
	default 1

config CLIP_DEFAULT_NOISE
	int "Default noise suppression level (dB)"
	default 12

config CLIP_DEFAULT_DEREVERB
	bool "Default dereverberation enabled"
	default y

config CLIP_AGC_MAX_GAIN
	int "AGC maximum gain (dB)"
	default 60

config CLIP_AGC_TARGET
	int "AGC target level"
	default 30000

config CLIP_AGC_INCREMENT
	int "AGC max increase (dB/s)"
	default 60

config CLIP_AGC_DECREMENT
	int "AGC max decrease (dB/s)"
	default -100

config CLIP_STORAGE_FULL_PERCENT
	int "SD usage percent at which recording is refused (storage full)"
	default 95
	range 50 99
	help
	  Recording is refused and a "Storage Full" error is shown when SD card
	  usage reaches this percentage (e.g. 95 = refuse at 95% full).

config CLIP_LOG_FS_DEFAULT_ON
	bool "Enable FS (SD card) log backend by default at boot"
	default y if LOG_BACKEND_UART
	help
	  FS log default follows the UART log backend: debug builds (which keep
	  UART logging) default FS log on (INF to /SD:/LOG); the production
	  snippet disables UART logging, so FS log defaults off there. The FS
	  log can still be toggled at runtime with AT+LOG=off|info|debug.
	  Coupling to LOG_BACKEND_UART (rather than overriding this symbol from
	  the production snippet) avoids broadcasting an app-only Kconfig symbol
	  into the mcuboot sysbuild image, where it is undefined.

config CLIP_DEFAULT_AUTODEL
	int "Default auto-delete days (-1 for off)"
	default -1

config CLIP_DEFAULT_BRIGHTNESS
	int "Default OLED brightness (0-255)"
	default 32

config CLIP_DISPLAY_STATUS_TIMEOUT_MS
	int "Status bar display timeout (ms)"
	default 10000

config CLIP_DISPLAY_PAIRING_TIMEOUT_MS
	int "Pairing guide display timeout (ms)"
	default 60000

config CLIP_SETTINGS_LOAD_TIMEOUT_MS
	int "settings_load watchdog timeout (ms)"
	default 3000

config CLIP_SD_IDLE_DELAY_MS
	int "SD card idle power-off delay (ms)"
	default 45000

config CLIP_ADV_FAST_TIMEOUT_MS
	int "BLE fast advertising timeout before dropping to slow (ms)"
	default 30000

config CLIP_WIFI_AP_CHANNEL
	int "Default WiFi AP channel (5GHz: 36-165)"
	default 36

config CLIP_WIFI_AP_REG_DOMAIN
	string "Default WiFi regulatory domain (2-letter country code)"
	default "US"

# =============================================================================
# Hardware Configuration (crystal caps, low-battery boot gate)
# =============================================================================

config CLIP_HFXO_CAPVALUE
	int "HFXO (32 MHz) crystal capacitance (raw XOSC32MCAPS.CAPVALUE)"
	default 60
	help
	  Raw CAPVALUE register field for the 32 MHz crystal internal load caps.
	  Set by clip_xo_cap_init() (SYS_INIT POST_KERNEL) — the HFXO DTS binding
	  can't take a raw CAPVALUE (it derives from FICR), so we override here.
	  Tune with the tests/clip "hfxo set" shell, then set here.

config CLIP_LFXO_INTCAP
	int "LFXO (32.768 kHz) internal capacitance (0=ext, 1=6pF, 2=7pF, 3=9pF)"
	range 0 3
	default 1
	help
	  INTCAP for the 32.768 kHz crystal (XOSC32KI.INTCAP). 0 = external caps,
	  1 = 6 pF, 2 = 7 pF, 3 = 9 pF internal. Set by clip_xo_cap_init().

# =============================================================================
# Button Configuration
# =============================================================================

# =============================================================================
# Haptic Motor Configuration
# =============================================================================

config CLIP_HAPTIC_MOTOR_ENABLED
	bool "Enable haptic motor"
	default n

config CLIP_HAPTIC_MOTOR_GPIO_PIN
	int "Haptic motor GPIO pin"
	default 6

# =============================================================================
# AT Server Configuration
# =============================================================================

config CLIP_AT_SERVER_QUEUE_SIZE
	int "AT command queue size"
	default 10

config CLIP_AT_SERVER_STACK_SIZE
	int "AT server thread stack size"
	default 4096

config CLIP_AT_SERVER_PRIORITY
	int "AT server thread priority"
	default 7

config CLIP_AT_MAX_CMD_LEN
	int "Maximum AT command length"
	default 256

config CLIP_AT_MAX_RESPONSE_LEN
	int "Maximum AT response length"
	default 1024

# =============================================================================
# Audio Configuration
# =============================================================================

config CLIP_AUDIO_STACK_SIZE
	int "Audio thread stack size"
	default 32768

config CLIP_AUDIO_THREAD_PRIORITY
	int "Audio thread priority"
	default 0

config CLIP_AUDIO_ENABLED
	bool "Enable audio recording"
	default y

config CLIP_AUDIO_DMIC_FLUSH_FRAMES
	int "Number of DMIC frames to discard on start/resume"
	range 0 20
	default 4
	help
	  Number of 20ms DMIC frames to discard after mic power-on
	  to eliminate pop/click from power-up transients.

# =============================================================================
# Storage Configuration
# =============================================================================

config CLIP_STORAGE_ENABLED
	bool "Enable SD card storage"
	default y

config CLIP_STORAGE_MAX_SESSIONS
	int "Maximum number of sessions to list"
	default 100

config CLIP_STORAGE_SESSIONS_PER_PAGE
	int "Sessions per page for LIST command"
	default 20

config CLIP_STORAGE_MAX_CHUNKS
	int "Maximum chunks per session"
	default 9999

config CLIP_STORAGE_CHUNK_SIZE
	int "Storage chunk buffer size (bytes)"
	default 4096

config CLIP_STORAGE_FILES_PER_GROUP
	int "Number of files per group subdirectory"
	default 100
	help
	  Maximum number of audio files stored in each group subdirectory.
	  When a session has many files, they are organized into
	  subdirectories (0, 1, 2...) to maintain FAT filesystem performance.
	  Group = (file_index - 1) / FILES_PER_GROUP.

# =============================================================================
# Audio Segment Configuration
# =============================================================================

config CLIP_AUDIO_SEGMENT_DURATION_SYNC
	int "Audio segment duration during sync (seconds)"
	range 10 600
	default 60

config CLIP_AUDIO_SEGMENT_DURATION_NO_SYNC
	int "Audio segment duration without sync (seconds)"
	range 20 3600
	default 300

# =============================================================================
# Transfer Configuration
# =============================================================================

config CLIP_TRANSFER_ENABLED
	bool "Enable file transfer"
	default y

config CLIP_TRANSFER_STACK_SIZE
	int "Transfer thread stack size"
	default 16384

config CLIP_TRANSFER_THREAD_PRIORITY
	int "Transfer thread priority"
	default 5

config CLIP_TRANSFER_CHUNK_SIZE
	int "Transfer chunk size (bytes)"
	default 4096
	help
	  Data chunk size for file transfer. Transport layer slices into
	  multiple frames as needed (UDP max frame is 1024 bytes).
	  BLE transport will split into multiple notifications automatically.

# =============================================================================
# UDP Transport Configuration
# =============================================================================

config CLIP_UDP_THREAD_STACK_SIZE
	int "UDP server thread stack size"
	default 4096

config CLIP_UDP_THREAD_PRIORITY
	int "UDP server thread priority"
	default 5

config CLIP_UDP_RECV_BUF_SIZE
	int "UDP receive buffer size"
	default 2048

config CLIP_UDP_SOCKET_BUF_SIZE
	int "UDP socket SO_RCVBUF/SO_SNDBUF size"
	default 4096

config CLIP_UDP_MAX_DATA_SIZE
	int "UDP maximum data per packet"
	default 1024

config CLIP_UDP_HEARTBEAT_INTERVAL_MS
	int "UDP heartbeat interval (ms)"
	default 5000

config CLIP_UDP_CONNECTION_TIMEOUT_MS
	int "UDP connection timeout (ms)"
	default 30000

config CLIP_UDP_SEND_BACKOFF_US
	int "UDP send-error backoff (us), 0 to disable"
	default 1000
	help
	  Delay after a UDP sendto failure before the next frame. Only fires on an
	  actual send error (the socket is blocking, so this is rare), as a brief
	  drain window. 0 disables.

config CLIP_UDP_FILE_END_DELAY_US
	int "UDP delay before FILE_END (us), 0 to disable"
	default 5000
	help
	  Pause after the last DATA frame and before sending FILE_END. UDP is
	  unordered, so FILE_END sent right after the last DATA can overtake it
	  and make the client compute the file CRC before all DATA arrives (NACK).
	  Lets in-flight DATA land first. 0 disables.

config CLIP_UDP_REPAIR_PACE_US
	int "UDP inter-frame pace during retransmit (us), 0 to disable"
	default 1000
	help
	  Delay between retransmitted DATA frames when repairing a NACKed file
	  (selective repeat OR whole-file). The link just dropped frames, so pacing
	  the retransmit avoids re-overwhelming it. Halves each repair round (递减)
	  toward full speed as the file converges; the next file's initial send is
	  always full speed. 0 disables.

config CLIP_UDP_NACK_BACKOFF_MS
	int "UDP backoff between NACK retry rounds (ms)"
	default 10
	help
	  Delay before each NACK retransmit round, multiplied by the retry number
	  (10 ms, 20 ms, 30 ms ...). Lets the WiFi channel settle before resending.
	  Was 50; lowered — the heartbeat keep-alive makes the link stable, so a
	  long backoff just slows recovery.

# =============================================================================
# WiFi Configuration
# =============================================================================

config CLIP_WIFI_TIMEOUT_MS
	int "WiFi AP auto-off timeout (ms), 0 to disable"
	default 180000
	help
	  Time in milliseconds before WiFi AP is automatically disabled.
	  Timer starts after AP is enabled, restarts on client disconnect.
	  Set to 0 to disable auto-off.

config COEX_SEP_ANTENNAS
	bool "WiFi and BLE use separate antennas"
	default n

config SR_PROTOCOL_BLE
	bool "Short Range protocol is Bluetooth LE"
	default y
	help
	  Tells the WiFi/BLE coexistence PTA that the short-range
	  protocol is BLE, enabling proper radio arbitration.

# =============================================================================
# Battery / Fuel-Gauge Configuration
# =============================================================================

config CLIP_BATTERY_WIFI_LOAD_COMPENSATION
	bool "Compensate fuel gauge for WiFi (nRF70) current the NPM1300 IBAT cannot see"
	default y
	help
	  The nRF7002 main VDD (BUCKVBAT) is tied to VBAT upstream of the NPM1300,
	  so its radio TX/RX/internal-buck current never flows through the PMIC's
	  IBAT sense resistor. GAUGE_AVG_CURRENT therefore undercounts discharge
	  (and over-counts charge while charging) whenever WiFi is on, so the fuel
	  gauge SoC reads high. Fold a state-keyed WiFi-load estimate into the
	  current fed to nrf_fuel_gauge_process() to cancel the blind spot, in both
	  charge and discharge states. Disable only for an uncompensated baseline.

config CLIP_BATTERY_WIFI_AP_LOAD_MA
	int "Measured unseen nRF70 current with AP up, idle (mA)"
	default 59
	help
	  nRF7002 current (mA) drawn from VBAT-direct while the WiFi AP is up
	  but no file transfer is active (beaconing + radio standby). This is a
	  REAL draw the NPM1300 IBAT cannot see, so it must be billed to the
	  fuel gauge. Calibrate on the VBAT rail (upstream of the NPM1300):
	  unseen = total - |IBAT| with the AP up.

config CLIP_BATTERY_WIFI_TX_LOAD_MA
	int "Measured unseen nRF70 current during active UDP transfer (mA)"
	default 99
	help
	  nRF7002 current (mA) drawn from VBAT-direct while a WiFi UDP file
	  transfer is active (AP up + transfer). Calibrate the same way as
	  CLIP_BATTERY_WIFI_AP_LOAD_MA during an active transfer.

config CLIP_BATTERY_IDLE_CURRENT_UA
	int "Average battery current while idle, fed to the fuel gauge (uA)"
	default 400
	help
	  At idle the PMIC's one-shot IBAT sample is taken while the CPU runs the
	  60 s poll itself (mA-level draw, ~1.09 mA LSB) and integrating that
	  single sample over the whole 60 s delta over-counts discharge (~3%/h
	  phantom). Nordic's guidance for low-power periods is that the idle
	  current is known ahead of time: when not charging/recording/
	  transferring, this value is fed to nrf_fuel_gauge_process instead of
	  the measurement (and passed to nrf_fuel_gauge_idle_set). Calibrate from
	  the idle power budget (production ~170 uA + BLE advertising + OLED
	  wakeups).

config CLIP_BATTERY_DISPLAY_MAX_STEP
	int "Max displayed SoC change per poll (%)"
	default 3
	help
	  Rate-limits the DISPLAYED state-of-charge toward the fuel-gauge value,
	  DIRECTIONALLY, polled every 60 s: while charging the display only moves
	  UP toward the gauge (catch up + track the charge); while discharging it
	  only moves DOWN (track depletion). A normal charge/discharge changes by
	  <= MAX_STEP per poll, so the display tracks it with ZERO lag. The gauge's
	  voltage-reconciliation up-correction (the ~5-15% first-reboot jump after
	  charge/discharge cycling) is therefore held while discharging (no upward
	  creep on a discharging battery) and only corrected on the next charge.
	  Set 0 to disable smoothing (display the raw gauge SoC directly). The
	  displayed value is persisted across reboot so it resumes from the value
	  shown before reboot (no cross-reboot lag accumulation).

# =============================================================================
# Debug Configuration
# =============================================================================

config CLIP_RESOURCE_STATS
	bool "Enable on-demand AT resource measurements"
	default n
	depends on THREAD_MONITOR && THREAD_NAME && INIT_STACKS
	depends on SYS_HEAP_RUNTIME_STATS && THREAD_RUNTIME_STATS
	help
	  Add read-only AT+RES CPU, system heap and thread stack measurements.
	  No periodic worker is created. Intended for instrumented test images.

config CLIP_DEBUG_STATS
	bool "Enable periodic thread stack and heap usage logging"
	default n
	help
	  Print thread stack usage and heap stats every 10 seconds.

config CLIP_WIFI_AUTH_LOG
	bool "Station authentication log diagnostics"
	depends on CLIP_WIFI_DIAG && LOG_BACKEND_FS
	help
	  Allow the existing LOG command while idle in the upload experiment.
	  Intended for bounded station-authentication tests, disabled by default.

config CLIP_WIFI_DIAG
	bool "Passive HTTPS station network diagnostics"
	depends on CLIP_HTTPS_POC && NET_STATISTICS_USER_API
	depends on NET_STATISTICS_PER_INTERFACE && NET_STATISTICS_IPV4 && NET_STATISTICS_TCP
	default n
	help
	  Cache software network counters around station setup and TLS connect.
	  USB NETDIAG reads only the cache; no hardware statistics RPC is used.

endif # CLIP
```

## prj.conf
```kconfig
# SPDX-License-Identifier: Apache-2.0
#
# Clip Application Configuration
# Refactored version with modular architecture
#

# ==============================================================================
# FPU + CMSIS-DSP
# ==============================================================================
CONFIG_FPU=y
CONFIG_FPU_SHARING=y
CONFIG_CMSIS_DSP=y

# ==============================================================================
# Logging Configuration
# ==============================================================================
CONFIG_LOG=y
CONFIG_ASSERT=n
# INF app logs kept; flash headroom comes from per-module WRN demotions
# (transfer, clip_event + the chatty modules trimmed as needed) instead of
# blanketing the whole app at WRN.
CONFIG_CLIP_LOG_LEVEL_INF=y
CONFIG_LOG_DEFAULT_LEVEL=0
CONFIG_LOG_MODE_DEFERRED=y
CONFIG_LOG_RUNTIME_FILTERING=y
CONFIG_LOG_BUFFER_SIZE=8192
CONFIG_LOG_PROCESS_THREAD=y

# FS log backend (SD card /SD:/LOG/)
CONFIG_LOG_BACKEND_FS=y
CONFIG_LOG_BACKEND_FS_DIR="/SD:/LOG"
CONFIG_LOG_BACKEND_FS_FILE_PREFIX="log."
CONFIG_LOG_BACKEND_FS_FILE_SIZE=131072
CONFIG_LOG_BACKEND_FS_FILES_LIMIT=20
CONFIG_LOG_BACKEND_FS_OVERWRITE=y
CONFIG_LOG_BACKEND_FS_APPEND_TO_NEWEST_FILE=y

# Minimize log output overhead
CONFIG_LOG_BACKEND_SHOW_COLOR=n
CONFIG_LOG_PRINTK=n

# Disable validation features to save flash
CONFIG_SPIN_VALIDATE=n
CONFIG_MEM_SLAB_POINTER_VALIDATE=n

# ==============================================================================
# Main Stack and Heap
# ==============================================================================
CONFIG_MAIN_STACK_SIZE=6144
CONFIG_HEAP_MEM_POOL_SIZE=77824
CONFIG_CLIP_AT_SERVER_STACK_SIZE=8192
CONFIG_CLIP_TRANSFER_STACK_SIZE=4096
CONFIG_CLIP_UDP_THREAD_STACK_SIZE=2048

# ==============================================================================
# Reboot Support
# ==============================================================================
CONFIG_REBOOT=y

# ==============================================================================
# Power Management (System ON Idle)
# ==============================================================================
CONFIG_PM=y
CONFIG_PM_DEVICE=y
CONFIG_PM_DEVICE_RUNTIME=y
CONFIG_TICKLESS_KERNEL=y

# ==============================================================================
# Thread Monitoring (disabled to save ~20KB flash)
# ==============================================================================
CONFIG_THREAD_MONITOR=n
CONFIG_THREAD_NAME=n
CONFIG_THREAD_RUNTIME_STATS=n
CONFIG_THREAD_RUNTIME_STATS_USE_TIMING_FUNCTIONS=n
CONFIG_INIT_STACKS=n
CONFIG_STACK_SENTINEL=n
CONFIG_SYS_HEAP_RUNTIME_STATS=n

# DWT cycle counter for precise timing measurement
CONFIG_CORTEX_M_DWT=y

# Debug stats (thread stack + heap usage)
CONFIG_CLIP_DEBUG_STATS=n

# ==============================================================================
# Retention subsystem for MCUboot USB DFU mode trigger
# ==============================================================================
CONFIG_RETAINED_MEM=y
CONFIG_RETENTION=y
CONFIG_RETENTION_BOOT_MODE=y

# ==============================================================================
# Bluetooth BLE Configuration (minimal for OTA)
# ==============================================================================
CONFIG_BT=y
CONFIG_BT_PERIPHERAL=y
CONFIG_BT_DEVICE_NAME="Clip"
CONFIG_BT_DEVICE_NAME_DYNAMIC=y
CONFIG_BT_MAX_CONN=1

# BLE throughput optimization
CONFIG_BT_BUF_ACL_RX_SIZE=517
CONFIG_BT_BUF_ACL_TX_SIZE=517
CONFIG_BT_L2CAP_TX_MTU=517
CONFIG_BT_GATT_CLIENT=y
CONFIG_BT_RX_STACK_SIZE=4096

# BLE Pairing & Bonding
CONFIG_BT_SMP=y
CONFIG_BT_BONDABLE=y
CONFIG_BT_MAX_PAIRED=1
# Debug: a new phone may pair and overwrite the single stored bond without
# first clearing it (convenient for testing). Production turns this OFF in
# snippets/production/snippet-production.conf so the device stays locked to
# its owner until an explicit AT+PAIR=reset.
CONFIG_BT_KEYS_OVERWRITE_OLDEST=y
CONFIG_BT_SETTINGS=y
CONFIG_BT_FILTER_ACCEPT_LIST=y
CONFIG_BT_GATT_SERVICE_CHANGED=y
CONFIG_BT_GATT_CACHING=y
CONFIG_BT_ASSERT_VERBOSE=n

# ==============================================================================
# GPIO and Regulators
# ==============================================================================
CONFIG_GPIO=y
CONFIG_REGULATOR=y

# Custom GPIO button driver
CONFIG_GPIO_BUTTON=y
CONFIG_INPUT_GPIO_BUTTON_OWN_THREAD=y
CONFIG_INPUT_GPIO_BUTTON_THREAD_STACK_SIZE=512
CONFIG_INPUT_GPIO_BUTTON_THREAD_PRIORITY=5

# Haptic motor control
CONFIG_CLIP_HAPTIC_MOTOR_ENABLED=y

# Display
CONFIG_DISPLAY=y

# I2C for PMIC and Display
CONFIG_I2C=y

# MFD and npm1300 charger/fuel-gauge sensor (required for SD card power)
CONFIG_MFD=y
CONFIG_SENSOR=y
CONFIG_NPM13XX_CHARGER=y

# Nordic nRF Fuel Gauge Library for accurate battery SoC estimation
CONFIG_NRF_FUEL_GAUGE=y
CONFIG_NRF_FUEL_GAUGE_VARIANT_SECONDARY_CELL=y

# BLE Battery Service
CONFIG_BT_BAS=y
CONFIG_BT_BAS_BLS=y
CONFIG_BT_BAS_BLS_BATTERY_LEVEL_PRESENT=y
CONFIG_BT_BAS_BLS_ADDITIONAL_STATUS_PRESENT=y

# ==============================================================================
# Settings and Storage
# ==============================================================================
CONFIG_FLASH=y
CONFIG_FLASH_MAP=y
CONFIG_SETTINGS=y

# File Systems
CONFIG_FILE_SYSTEM=y

# LittleFS for settings
CONFIG_FILE_SYSTEM_LITTLEFS=y
CONFIG_FS_LITTLEFS_FMP_DEV=y
CONFIG_FS_LITTLEFS_FC_HEAP_SIZE=4096
CONFIG_FS_LITTLEFS_NUM_FILES=16
CONFIG_FS_LITTLEFS_NUM_DIRS=4

# FATFS for SD card
CONFIG_FAT_FILESYSTEM_ELM=y
CONFIG_FS_FATFS_LFN=y
CONFIG_FS_FATFS_LFN_MODE_HEAP=y
CONFIG_FS_FATFS_REENTRANT=y
CONFIG_DISK_ACCESS=y
CONFIG_DISK_DRIVER_SDMMC=y

CONFIG_SETTINGS_FILE=y
CONFIG_SETTINGS_FILE_PATH="/lfs/settings/run"
CONFIG_SETTINGS_FILE_MAX_LINES=16

# ==============================================================================
# Bluetooth OTA DFU (MCUmgr) - App core + Network core
# ==============================================================================
CONFIG_NCS_SAMPLE_MCUMGR_BT_OTA_DFU=y
CONFIG_MCUMGR_GRP_IMG_UPDATABLE_IMAGE_NUMBER=2
CONFIG_MCUMGR_MGMT_NOTIFICATION_HOOKS=y
CONFIG_MCUMGR_GRP_IMG_STATUS_HOOKS=y
CONFIG_MCUMGR_GRP_IMG_UPLOAD_CHECK_HOOK=y

CONFIG_SYSTEM_WORKQUEUE_STACK_SIZE=4096

CONFIG_NEWLIB_LIBC=y
CONFIG_NEWLIB_LIBC_NANO=y

# ==============================================================================
# Flash Size Optimization (-Oz)
# ==============================================================================
CONFIG_NO_OPTIMIZATIONS=n
CONFIG_DEBUG_OPTIMIZATIONS=n
CONFIG_SPEED_OPTIMIZATIONS=n
CONFIG_SIZE_OPTIMIZATIONS=n
CONFIG_SIZE_OPTIMIZATIONS_AGGRESSIVE=y

# Link Time Optimization
CONFIG_ISR_TABLES_LOCAL_DECLARATION=y
CONFIG_LTO=y

# ==============================================================================
# Audio Configuration (DMIC + Opus + SpeexDSP)
# ==============================================================================
CONFIG_CLIP_AUDIO_ENABLED=y

# DMIC (PDM Microphone)
CONFIG_AUDIO=y
CONFIG_AUDIO_DMIC=y

# Opus Codec
CONFIG_OPUS_CODEC=y

# SpeexDSP for audio preprocessing (noise suppression, AGC, dereverb)
# Only used in enhanced/merge mode, not in stereo mode
CONFIG_SPEEXDSP=y

# Thread stack for audio (needs more space for Opus encoding)
CONFIG_CLIP_AUDIO_STACK_SIZE=32768
CONFIG_CLIP_AUDIO_THREAD_PRIORITY=0

# =============================================================================
# Audio Segment Duration (configured via Kconfig, not hardcoded here)
# Use CLIP_AUDIO_SEGMENT_DURATION_SYNC and CLIP_AUDIO_SEGMENT_DURATION_NO_SYNC
# from Kconfig to set these values (default: 60s and 300s)
# =============================================================================
CONFIG_CLIP_AUDIO_SEGMENT_DURATION_SYNC=60
CONFIG_CLIP_AUDIO_SEGMENT_DURATION_NO_SYNC=300

CONFIG_CLIP_STORAGE_FILES_PER_GROUP=100

# ==============================================================================
# WiFi AP Configuration
# ==============================================================================
# nRF7002 firmware patches stored on external SPI flash (saves ~87KB internal)
# ==============================================================================
CONFIG_WIFI=y
CONFIG_WIFI_NRF70=y
CONFIG_NRF70_AP_MODE=y

# WiFi/BLE coexistence: MPSL_CX=y on net core + NRF70_SR_COEX=y on app core.
# NRF70_SR_COEX_RF_SWITCH is NOT enabled (no RF switch hardware on this board).
CONFIG_NRF70_SR_COEX=y
CONFIG_WIFI_NM_WPA_SUPPLICANT=y
CONFIG_WIFI_NM_WPA_SUPPLICANT_AP=y
# Suppress WPA supplicant log strings (saves ~10KB flash)
CONFIG_WIFI_NM_WPA_SUPPLICANT_LOG_LEVEL_ERR=y
# Disable WPA3/SAE — device uses WPA2-PSK only (saves ~23KB flash)
CONFIG_WIFI_NM_WPA_SUPPLICANT_WPA3_IMPLEMENTATION_NONE=y

# AP-only mode — STA infrastructure required by AP code, cannot disable
# CONFIG_NRF70_STA_MODE=n

# Crypto: SHA512/DHM disable caused sta_set_flags errors, keep enabled for now
# CONFIG_MBEDTLS_SHA512_C=n
# CONFIG_MBEDTLS_SHA384_C=n
# CONFIG_MBEDTLS_DHM_C=n
CONFIG_WIFI_RANDOM_MAC_ADDRESS=y

# WiFi ready callback library (for runtime net_if_up)
CONFIG_WIFI_READY_LIB=y

# WiFi driver manual start (user must call net_if_up before AP mode)
# This saves ~30mA when WiFi is not in use.
CONFIG_NRF_WIFI_IF_AUTO_START=n

# QSPI low power mode (saves ~0.1-0.3mA when WiFi is off)
CONFIG_NRF70_QSPI_LOW_POWER=y

# Minimal networking stack (IPv4 + UDP + DHCP, no IPv6/TCP)
CONFIG_NETWORKING=y
CONFIG_NET_L2_ETHERNET=y
CONFIG_NET_L2_WIFI_MGMT=y
CONFIG_NET_IPV4=y
CONFIG_NET_IPV6=n
CONFIG_NET_UDP=y
CONFIG_NET_TCP=n
CONFIG_NET_SOCKETS=y
CONFIG_NET_DHCPV4=y
CONFIG_NET_DHCPV4_SERVER=y
CONFIG_NET_DHCPV4_SERVER_ADDR_COUNT=1
CONFIG_NET_MGMT=y
CONFIG_NET_MGMT_EVENT=y
CONFIG_NET_CONFIG_SETTINGS=y
CONFIG_NET_CONFIG_INIT_TIMEOUT=0
CONFIG_NET_LOG=n

# AP static IP
CONFIG_NET_IF_UNICAST_IPV4_ADDR_COUNT=1
CONFIG_NET_CONFIG_MY_IPV4_ADDR="192.168.4.1"
CONFIG_NET_CONFIG_MY_IPV4_NETMASK="255.255.255.0"
CONFIG_NET_CONFIG_MY_IPV4_GW="192.168.4.1"

CONFIG_MBEDTLS_HEAP_SIZE=1024


# Minimal WiFi buffer sizes (tune for RAM/flash balance)
CONFIG_NET_PKT_RX_COUNT=8
CONFIG_NET_PKT_TX_COUNT=24
CONFIG_NET_BUF_RX_COUNT=16
CONFIG_NET_BUF_TX_COUNT=32
CONFIG_NET_PKT_BUF_TX_DATA_POOL_SIZE=16384
CONFIG_CLIP_UDP_SOCKET_BUF_SIZE=4096
CONFIG_NRF70_RX_NUM_BUFS=8
CONFIG_NRF70_MAX_TX_AGGREGATION=4
CONFIG_NRF_WIFI_CTRL_HEAP_SIZE=20000
CONFIG_NRF_WIFI_DATA_HEAP_SIZE=40000

CONFIG_NET_TC_TX_COUNT=1
CONFIG_NET_IF_UNICAST_IPV4_ADDR_COUNT=1
CONFIG_NET_MAX_CONTEXTS=8
CONFIG_NET_MAX_CONN=6
CONFIG_NET_CONTEXT_SYNC_RECV=y
CONFIG_NET_CONFIG_SETTINGS=y
CONFIG_NET_CONFIG_INIT_TIMEOUT=0
CONFIG_NET_SOCKETS_POLL_MAX=4
CONFIG_NET_TCP_TIME_WAIT_DELAY=0
CONFIG_NET_TCP_WORKQ_STACK_SIZE=2048

CONFIG_NET_RX_STACK_SIZE=2048
CONFIG_NET_TX_STACK_SIZE=2048

CONFIG_NRF70_IRQ_WQ_STACK_SIZE=1024

CONFIG_WIFI_NM_WPA_SUPPLICANT_THREAD_STACK_SIZE=10240
CONFIG_WIFI_NM_WPA_SUPPLICANT_WQ_STACK_SIZE=2048

# Required by WPA supplicant
CONFIG_POSIX_TIMERS=y
CONFIG_ENTROPY_GENERATOR=y

# Hardware info for SSID generation from chip ID
CONFIG_HWINFO=y

# ==============================================================================
# USB - CDC ACM (AT command serial) + MSC (SD card, on demand)
# ==============================================================================
CONFIG_USB_DEVICE_STACK_NEXT=y

# 1200-baud USB CDC -> mcuboot DFU trigger (hook is on via the board default
# CONFIG_CLIP_USB_DFU=y). The clip app brings its own BLE-gated CDC+MSC, so
# disable the module's default CDC (which is for apps without a USB stack).
CONFIG_CLIP_USB_DFU_DEFAULT_CDC=n

# CDC ACM (virtual serial port for AT commands)
CONFIG_USBD_CDC_ACM_CLASS=y
CONFIG_SERIAL=y
CONFIG_UART_INTERRUPT_DRIVEN=y
CONFIG_UART_LINE_CTRL=y

# MSC (Mass Storage, enabled via AT+MSC=on)
CONFIG_USBD_MSC_CLASS=y
CONFIG_USBD_MSC_LUNS_PER_INSTANCE=1
CONFIG_USBD_MSC_DOUBLE_BUFFERING=n
CONFIG_USBD_MSC_SCSI_BUFFER_SIZE=512
CONFIG_USBD_MSC_STACK_SIZE=1024
```

## dtls-aead-hardware.conf
```kconfig
# Experimental overlay: use CryptoCell AEAD, retaining the software backend
# for hashes, MACs, ciphers and asymmetric handshake operations.
# The pinned SDK groups GCM and CCM under the same AEAD driver switch.
CONFIG_PSA_CRYPTO_DRIVER_CC3XX=y
CONFIG_PSA_USE_CC3XX_AEAD_DRIVER=y
CONFIG_PSA_USE_CC3XX_CIPHER_DRIVER=n
CONFIG_PSA_USE_CC3XX_HASH_DRIVER=n
CONFIG_PSA_USE_CC3XX_MAC_DRIVER=n
CONFIG_PSA_USE_CC3XX_KEY_AGREEMENT_DRIVER=n
CONFIG_PSA_USE_CC3XX_ASYMMETRIC_SIGNATURE_DRIVER=n
CONFIG_PSA_USE_CC3XX_ASYMMETRIC_ENCRYPTION_DRIVER=n
CONFIG_PSA_USE_CC3XX_KEY_MANAGEMENT_DRIVER=n
```

## dtls-prepare-profile.conf
```kconfig
# Diagnostic only: full candidate plus preparation/OPEN/DATA/cleanup timing.
CONFIG_CLIP_HTTPS_PROFILE=y
CONFIG_CLIP_DTLS_PREPARE_MEASURE=y
```

## dtls-profile.conf
```kconfig
CONFIG_CLIP_DTLS_PROFILE=y
```

## dtls-upload-optimized.conf
```kconfig
# Candidate defaults selected by measured device uploads, not a release signoff.
# Apply after dtls-upload.conf and dtls-aead-hardware.conf.
CONFIG_CLIP_DTLS_INITIAL_WINDOW_PACKETS=128
CONFIG_CLIP_DTLS_WINDOW_PACKETS=128
CONFIG_CLIP_DTLS_READ_CACHE_BYTES=8192
```

## dtls-upload.conf
```kconfig
# App-only complete recording firmware; no upload-bench sources or 64KiB cache.
CONFIG_CLIP_DTLS_UPLOAD=y
CONFIG_MBEDTLS_SSL_PROTO_DTLS=y
CONFIG_CLIP_DTLS_WINDOW_PACKETS=64
# Keep directional pools modest. The window is logical, not a payload cache.
CONFIG_NET_PKT_BUF_TX_DATA_POOL_SIZE=24576
CONFIG_NET_PKT_BUF_RX_DATA_POOL_SIZE=4096
CONFIG_NET_PKT_TX_COUNT=24
CONFIG_NET_BUF_TX_COUNT=32
CONFIG_HEAP_MEM_POOL_SIZE=73728
# Make room for the measured DTLS call stack without removing product features.
CONFIG_LOG_BUFFER_SIZE=4096
CONFIG_CLIP_TCP_TRACE=n
CONFIG_CLIP_HTTPS_PROFILE=n
CONFIG_HTTP_CLIENT=n
```

## https-arp-backport.conf
```kconfig
# Isolate ARP fixes against the existing fresh-DHCP baseline.
CONFIG_NET_DHCPV4_INIT_REBOOT=n
CONFIG_CLIP_NETWORK_BACKPORT_DHCP=n
CONFIG_CLIP_NETWORK_BACKPORT_ARP=y
```

## include/battery.h
```c
/*
 * Copyright (c) 2025 Seeed Technology Co., Ltd.
 *
 * SPDX-License-Identifier: Apache-2.0
 */

#ifndef CLIP_BATTERY_H
#define CLIP_BATTERY_H

/**
 * @brief Initialize battery monitoring
 *
 * Sets up NPM1300 interrupt callbacks for charging events (VBUS, charge complete)
 * and starts periodic battery level polling (60s interval).
 * Updates BLE Battery Service with level and charging status.
 *
 * @return 0 on success, negative error code on failure
 */
int battery_init(void);

/**
 * @brief Milliseconds since the fuel-gauge state was last persisted
 *        (INT64_MAX when never). Lets shutdown skip a redundant save.
 */
int64_t battery_fg_state_age_ms(void);

/**
 * @brief Poll battery status immediately
 *
 * Reads sensors, updates fuel gauge SoC, and refreshes display/BLE.
 * Call this when the user triggers a status bar display to get fresh readings.
 */
void battery_poll(void);

/**
 * @brief Persist the nRF Fuel Gauge state to settings (LittleFS)
 *
 * Saves the fuel gauge internal state so the SoC is continuous across reboots
 * (without this, every reboot re-estimates SoC from the resting voltage and
 * the displayed % jumps). Called on SoC change (infrequent) + on graceful
 * shutdown/reboot (a fresh copy before power-off).
 */
void battery_save_fg_state(void);

/* VBUS present (USB plugged), regardless of active charging — a full pack on
 * USB still has VBUS up and the PMIC refuses ship mode. Power-off paths gate
 * on this, NOT on status.battery_charging (false once the charge completes). */
bool battery_vbus_present(void);

/* Recording allowed? Latched off at critical battery (raw SoC <=3% or
 * <=3.45V; a graceful STOP runs there), unlocked by charging/VBUS or
 * recovery to >=8%. VBUS alone unlocks (external power). START paths
 * (AT + button) gate on this. */
bool battery_recording_allowed(void);

#endif /* CLIP_BATTERY_H */
```

## include/clip.h
```c
/*
 * Copyright (c) 2025 Seeed Technology Co., Ltd.
 *
 * SPDX-License-Identifier: Apache-2.0
 */

#ifndef CLIP_H
#define CLIP_H

#include <zephyr/kernel.h>
#include <zephyr/device.h>
#include <zephyr/sys/util.h>
#include <app_version.h>
#include <stdint.h>
#include <stdbool.h>

/* Version string: "X.Y.Z" when TWEAK=0, "X.Y.Z+N" when TWEAK>0. */
#if APP_TWEAK > 0
#define CLIP_VERSION APP_VERSION_TWEAK_STRING
#else
#define CLIP_VERSION APP_VERSION_STRING
#endif

/**
 * @brief Clip error codes
 */
#define CLIP_OK           0
#define CLIP_ERR_INVALID -1
#define CLIP_ERR_BUSY    -2
#define CLIP_ERR_NO_MEM  -3
#define CLIP_ERR_IO      -4
#define CLIP_ERR_TIMEOUT -5

/**
 * @brief Device states
 */
enum clip_state {
    CLIP_STATE_UNINITIALIZED = 0,
    CLIP_STATE_IDLE,
    CLIP_STATE_RECORDING,
    CLIP_STATE_TRANSMITTING,
    CLIP_STATE_WIFI_SYNC,
    CLIP_STATE_PAUSED,
    CLIP_STATE_ERROR,
    CLIP_STATE_OTA,
};

/**
 * @brief Recording modes
 */
enum recording_mode {
    MODE_NORMAL = 0,
    MODE_ENHANCED,
};

/**
 * @brief Event handler callback type
 */
typedef void (*event_handler_t)(int event, void *data);

/**
 * @brief Clip context structure
 *
 * Central structure that holds all application state.
 * This replaces global variables and enables better modularity.
 */
struct clip_context {
    /* Configuration */
    struct clip_config {
        uint8_t mode;               /* Recording mode (normal/enhanced) */
        uint8_t noise_suppress;     /* Noise suppression level (dB) */
        bool dereverb_enabled;      /* Dereverberation enabled */
        uint8_t oled_brightness;    /* OLED brightness (0-255) */
        char wifi_password[9];      /* WiFi AP password (8 chars + NUL) */
        char device_name[257];      /* User-defined device name (256 bytes + NUL) */
        uint8_t wifi_channel;       /* WiFi AP channel (default 36) */
        char wifi_reg_domain[3];    /* WiFi regulatory domain (2 chars + NUL, default "US") */
    } config;

    /* Status */
    struct clip_status {
        uint8_t battery_percent;
        bool battery_charging;
        int8_t battery_temp;        /* Battery temperature (°C, NTC) */
        uint16_t battery_mv;        /* Battery voltage (mV) */
        uint32_t recording_time;
        uint32_t free_space;
        uint16_t session_count;
    } status;

    /* Time sync */
    struct clip_time {
        uint16_t year;
        uint8_t month;
        uint8_t day;
        uint8_t hour;
        uint8_t min;
        uint8_t sec;
        int64_t base_uptime_ms;
        bool valid;
    } time;
};

/**
 * @brief Get the global clip context
 *
 * @return Pointer to the clip context
 */
struct clip_context *clip_get_context(void);

void clip_cpu_boost_acquire(void);
void clip_cpu_boost_release(void);

/**
 * @brief Initialize clip application
 *
 * @return 0 on success, negative error code on failure
 */
int clip_init(void);

/**
 * @brief Main application loop
 */
void clip_main_loop(void);

/**
 * @brief Get current synchronized time
 *
 * @param out_year Output year
 * @param out_month Output month
 * @param out_day Output day
 * @param out_hour Output hour
 * @param out_min Output minute
 * @param out_sec Output second
 * @return true if time is valid, false otherwise
 */
bool clip_get_current_time(uint16_t *out_year, uint8_t *out_month, uint8_t *out_day,
                           uint8_t *out_hour, uint8_t *out_min, uint8_t *out_sec);

/**
 * @brief Convert state to string
 *
 * @param state State to convert
 * @return String representation
 */
const char *clip_state_to_string(enum clip_state state);

#endif /* CLIP_H */
```

## include/config.h
```c
/*
 * Copyright (c) 2025 Seeed Technology Co., Ltd.
 *
 * SPDX-License-Identifier: Apache-2.0
 */

#ifndef CLIP_CONFIG_H
#define CLIP_CONFIG_H

#include <stdint.h>
#include <stddef.h>
#include "clip.h"

/* Configuration keys */
#define CONFIG_KEY_MODE          0x03
#define CONFIG_KEY_NOISE         0x04
#define CONFIG_KEY_DEREVERB      0x09
#define CONFIG_KEY_BRIGHTNESS    0x0A
#define CONFIG_KEY_WIFI_PASSWORD 0x0B
#define CONFIG_KEY_DEVICE_NAME   0x0C
#define CONFIG_KEY_WIFI_CHANNEL  0x0D
#define CONFIG_KEY_WIFI_REG_DOMAIN 0x0E


/**
 * @brief Initialize configuration system
 *
 * @return 0 on success, negative error code on failure
 */
int config_init(void);

/**
 * @brief Load configuration from storage
 *
 * @return 0 on success, negative error code on failure
 */
int config_load(void);

/**
 * @brief Save configuration to storage
 *
 * @return 0 on success, negative error code on failure
 */
int config_save(void);

/**
 * @brief Reset configuration to factory defaults
 *
 * @return 0 on success, negative error code on failure
 */
int config_factory_reset(void);

/**
 * @brief Set configuration value
 *
 * @param key   Configuration key
 * @param value Pointer to value
 * @param len   Length of value
 * @return 0 on success, negative error code on failure
 */
int config_set(uint16_t key, const void *value, size_t len);

/**
 * @brief Get configuration value
 *
 * @param key    Configuration key
 * @param value  Output buffer
 * @param len    Length of buffer
 * @return 0 on success, negative error code on failure
 */
int config_get(uint16_t key, void *value, size_t len);

/**
 * @brief Save Unix timestamp to storage
 *
 * @param unix_time Unix timestamp
 * @return 0 on success, negative error code on failure
 */
int config_set_time(int64_t unix_time);

/**
 * @brief Get Unix timestamp from storage
 *
 * @param unix_time Output buffer for Unix timestamp
 * @return 0 on success, negative error code if time not set
 */
int config_get_time(int64_t *unix_time);

/**
 * @brief Set time values (YMDHMS)
 *
 * @param year Year
 * @param month Month (1-12)
 * @param day Day (1-31)
 * @param hour Hour (0-23)
 * @param min Minute (0-59)
 * @param sec Second (0-59)
 * @return 0 on success, negative error code on failure
 */
int config_set_time_ymd(uint16_t year, uint8_t month, uint8_t day,
                        uint8_t hour, uint8_t min, uint8_t sec);

/**
 * @brief Sync time baseline using current compensated time
 *
 * Recalculates current time from uptime compensation, then writes
 * it back as the new baseline. Call periodically (e.g. on recording
 * stop) to prevent long-term drift in the uptime-based clock.
 */
void config_sync_time(void);

/**
 * @brief Set recording mode
 *
 * @param mode Recording mode
 * @return 0 on success, negative error code on failure
 */
int config_set_mode(enum recording_mode mode);

/**
 * @brief Set noise suppression level
 *
 * @param noise Noise suppression in dB
 * @return 0 on success, negative error code on failure
 */
int config_set_noise_suppress(uint8_t noise);

/**
 * @brief Set auto-delete days
 *
 * @param days Days (0-30) or -1 for off
 * @return 0 on success, negative error code on failure
 */

/**
 * @brief Set dereverb enabled
 *
 * @param enabled true to enable, false to disable
 * @return 0 on success, negative error code on failure
 */
int config_set_dereverb_enabled(bool enabled);

/**
 * @brief Set OLED brightness
 *
 * @param brightness Brightness (0-255)
 * @return 0 on success, negative error code on failure
 */
int config_set_oled_brightness(uint8_t brightness);

/**
 * @brief Generate a random WiFi AP password and save to config
 *
 * Generates 8-char alphanumeric password (excluding 0/O/l/1/I).
 *
 * @return 0 on success, negative error code on failure
 */
int config_generate_wifi_password(void);

/**
 * @brief Set WiFi AP password
 *
 * @param password Password string (up to 8 chars)
 * @return 0 on success, negative error code on failure
 */
int config_set_wifi_password(const char *password);

/**
 * @brief Get WiFi AP password
 *
 * @return Password string, or "12345678" if not set
 */
const char *config_get_wifi_password(void);

/**
 * @brief Set device name
 *
 * @param name Device name string (1-32 chars, printable UTF-8)
 * @return 0 on success, negative error code on failure
 */
int config_set_device_name(const char *name);

/**
 * @brief Get device name
 *
 * @return Device name string, or empty string if not set
 */
const char *config_get_device_name(void);

/**
 * @brief Set WiFi AP channel
 *
 * @param channel Channel number (5GHz: 36-165)
 * @return 0 on success, negative error code on failure
 */
int config_set_wifi_channel(uint8_t channel);

/**
 * @brief Get WiFi AP channel
 *
 * @return Channel number
 */
uint8_t config_get_wifi_channel(void);

/**
 * @brief Set WiFi regulatory domain
 *
 * @param reg_domain 2-letter country code
 * @return 0 on success, negative error code on failure
 */
int config_set_wifi_reg_domain(const char *reg_domain);

/**
 * @brief Get WiFi regulatory domain
 *
 * @return 2-letter country code string
 */
const char *config_get_wifi_reg_domain(void);

/**
 * @brief Arm/disarm the settings_load watchdog
 *
 * settings_load can block for ~40s on a corrupt settings file and cannot
 * be interrupted. Arm a watchdog (on the system workqueue thread, which
 * runs independently of the main thread where settings_load executes)
 * before a settings_load_subtree() call; if it hasn't returned within
 * SETTINGS_LOAD_TIMEOUT_MS, the watchdog wipes the file and reboots.
 */
void settings_load_watchdog_arm(void);
void settings_load_watchdog_disarm(void);

#endif /* CLIP_CONFIG_H */
```

## include/dtls_bench.h
```c
#ifndef CLIP_DTLS_BENCH_H
#define CLIP_DTLS_BENCH_H
#include <stddef.h>
#include <stdint.h>
#include <stdbool.h>
struct dtls_bench_result {
    uint32_t size, confirmed, packets, retransmissions, acknowledgments;
    uint32_t prepare_us, handshake_us, transfer_us, fs_read_us, write_us, wait_us, raw_send_us;
    uint32_t read_us, raw_receive_us, fs_write_us, verify_us, sync_us, received_bytes, repair_requests, duplicates;
    uint32_t rejected_kind, rejected_offset;
    int error, tls_error;
    char run[17];
    char output[64], actual_sha256[65];
};
int dtls_bench_run(const char *path, const char *host, const char *port, const char *token,
                   const unsigned char *ca, size_t ca_size, uint8_t *batch, size_t capacity,
                   unsigned int window, unsigned int download, int (*check)(void),
                   void (*notify)(uint32_t sent, uint32_t confirmed),
                   struct dtls_bench_result *result);
#endif
```

## include/resource_stats.h
```c
/* SPDX-License-Identifier: Apache-2.0 */
#ifndef CLIP_RESOURCE_STATS_H
#define CLIP_RESOURCE_STATS_H

int resource_stats_register(void);

#endif
```
